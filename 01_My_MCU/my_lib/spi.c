//--------------------------------------------------------------------------------------------------------
//--------------------------------------------------------------------------------------------------------
/*
 * 
 *
 * Created: 
 *  Author: 
 */ 
//--------------------------------------------------------------------------------------------------------
//--------------------------------------------------------------------------------------------------------

#include "my_lib\spi.h"

//-----------------------------------------------------------------------------
// static volatile uint8_t		AdcMeasureCounters = 0;//счетчик измерений.
// static volatile uint16_t	AdcResult = 0;		   //Результат измерения. 
//-----------------------------------------------------------------------------
void spi_init(void){
	
	//настройка портов ввода-вывода все выводы, кроме MISO выходы.
	SPI_DDR  |= (SPI_MOSI | SPI_SCK | SPI_SS);
	SPI_PORT |= (SPI_MOSI | SPI_SCK | SPI_MISO);
	SPI_PORT &= ~SPI_SS;
	//------------------------------
	//разрешение spi,старший бит вперед,мастер, режим 0.
	SPCR = (1<<SPE)|(0<<DORD)|(1<<MSTR)|(0<<CPOL)|(0<<CPHA)|(1<<SPR1)|(0<<SPR0);
	SPSR = (0<<SPI2X);				
}
//-----------------------------------------------------------------------------
void spi_write_byte(uint8_t data){
		
	SPI_PORT &= ~SPI_SS;
	
	SPDR = data;
	while(!(SPSR & (1<<SPIF)));
	
	SPI_PORT |=  SPI_SS;
	SPI_PORT &= ~SPI_SS; 
	
//	SPI_PORT &= ~SPI_SS;
}
//-----------------------------------------------------------------------------
uint8_t spi_write_array(uint8_t num, uint8_t *data){
	
	volatile uint8_t input = 0;
	
	SPI_PORT &= ~SPI_SS;
	
	while(num--)
		{
			//Загрузка параллелных данных в DD4.
			WRITE_PORT &= ~WRITE_LEG;//
			_delay_us(10);
			WRITE_PORT |= WRITE_LEG;
			//Запись и чтение дынных в SPI.
			SPDR = *data++;
			while(!(SPSR & (1<<SPIF)));
			input = SPDR;
		}
		
	SPI_PORT |=  SPI_SS;
	SPI_PORT &= ~SPI_SS;

	return (~input);
}
//--------------------------------------------------------------------------------------------------------
//--------------------------------------------------------------------------------------------------------






